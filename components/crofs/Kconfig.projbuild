## components/crofs/Kconfig.projbuild
```kconfig
menu "CroFS Configuration"

config CROFS_SRC
    string "Source paths (blank separated and relative to project root)"
    default ""
    help
        Specifies the path(s) whose contents will be copied
        to the image file.

        The paths must be relative to the root of the current
        project.

        If empty, a filesystem will not be embedded automatically
        and you'll need to provide one by some other means.

config CROFS_LEVEL
    int "Compression level (0 - 10)"
    range 0 10
    default 6
    help
        Allows you to specify the compression level with a range
        of 0 to 10.

        A value of 0 disables compression, while a value of 1 to 10
        can be used with increasing amounts of compression.

        The default is 6.

config CROFS_EMBED
    bool
    default y if CROFS_SRC != ""

endmenu
```
